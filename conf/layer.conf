## conf/layer.conf
```bitbake
# We have a conf and classes directory, add to BBPATH
BBPATH .= ":${LAYERDIR}"

# We have recipes-* directories, add to BBFILES
BBFILES += "${LAYERDIR}/recipes-*/*/*.bb \
            ${LAYERDIR}/recipes-*/*/*.bbappend"

BBFILE_COLLECTIONS += "meta-sushme"
BBFILE_PATTERN_meta-sushme = "^${LAYERDIR}/"
BBFILE_PRIORITY_meta-sushme = "6"

LAYERDEPENDS_meta-sushme = "core"
LAYERSERIES_COMPAT_meta-sushme = "dunfell"
```
